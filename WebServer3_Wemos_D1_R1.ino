// Подключаем библиотеки

#include <WebSocketsClient.h>
#include "ArduinoJson.h"
#define VREF 3.27  // esp12 ~ 3.3
#define DIV_R1 50000
#define DIV_R2 2000

// Определяем название и пароль точки доступа
const char* ssid = "ITS";
const char* password = "daycom214";

// Определяем адрес сервера (например "192.168.1.3")
const char* ADDR = "test.websocket.alexrusakov.ru";  //

// Определяем url подключения
const char* URL = "/";

// Определяем порт
const uint16_t PORT = 7000;

// Создаём массив для отправки
int sdata[2]{ 1984, 11276 };

// Создаём массив для получения
unsigned long rdata[3]{ 0 };

// Кол-во элементов массива для получения
const size_t glen = sizeof(rdata) / sizeof(rdata[0]);
int Gmode = 0;    // глобалка, в которо хранится текущее состояние платы
int tmpMode = 0;  // глобалка для сравнения изменения состояния режима работы светильника
float Gvoltage = 0;
float GcurretnVoltage = 0;
float GcurrentLon = 0;
float GcurrentLat = 0;
// Создаём экземпляр класса клиента
WebSocketsClient webSocket;
StaticJsonDocument<300> parsed;

//общий json с исходными данными
char JSONSend[] = "{\"command\":\"setDeviceClientData\",\"clientUUID\":\"fd237235-cdd7-4a13-8258-test-ilia\",\"clientData\":{\"lampON\":true,\"deviceStatus\":0,\"buttonStatus\":\"down\",\"voltage\":5}}";
char jss[] = "{\"command\":\"deviceDataChanged\",\"deviceUUID\":\"01_10_2025_test_device1\",\"deviceData\":{\"dataKey\":\"deviceStatus\",\"dataValue\":50}}";
bool falseInit = false;  // разовая инициализация
String mac = "";

const long interval = 500;  // период отправки состояния GPS
unsigned long previousMillis = 0;
const long interval2 = 10000;  // период отправки состояния АКБ
unsigned long previousMillis2 = 0;
const long interval3 = 1000;  // период отправки состояния Кнопки, если данные изменились
unsigned long previousMillis3 = 0;

#define BP1 14         // D5
#define BP2 4          // D2
#define BP3 5          // D1
#define BP4 16         // D0
#define BUTTON_PIN 12  // PIN D6
#define dynPin 13  // PIN D7

////////////////////////////////////////////////// тестовый массив координа со стравы
//float glat[] = { 47.6758770, 47.6758570, 47.6758320, 47.6758160, 47.6758120, 47.6758060, 47.6758060, 47.6758030, 47.6758180, 47.6758770, 47.6758910, 47.6758140, 47.6758130,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 47.6844300, 47.6844660 };
//float glon[] = { 40.2027440, 40.2027030, 40.2026590, 40.2026190, 40.2026070, 40.2025790, 40.2025640, 40.2025450, 40.2025240, 40.2025040, 40.2024910, 40.2024070, 40.2023810,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 40.2005730, 40.2005770 };
float glat[] = {47.6750700,47.6750590,47.6750440,47.6750370,47.6750320,47.6750270,47.6750230,47.6750130,47.6750020,47.6749920,47.6749850,47.6749760,47.6749640,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47.6723920,47.6724040};
float glon[] = {40.2032460,40.2032400,40.2032280,40.2032170,40.2032110,40.2032050,40.2032010,40.2031860,40.2031720,40.2031590,40.2031500,40.2031400,40.2031280,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40.2064610,40.2064720};

int maxsize = sizeof(glat) / sizeof(glat[0]);
int nextgps = 0;
///////////////////////////////////////////////// Блок пищалки
unsigned long previousMillis4 = 0;
bool buzzerState = false;
const unsigned long buzzerOnTime = 100;    // время включения (мс)
const unsigned long buzzerOffTime = 900;   // время выключения (мс)
const int buzzerFrequency = 500;   
bool Gbuzz=false;


//////////////////////////
void setup() {

  // Инициируем последовательный порт
  Serial.begin(115200);
  pinMode(LED_BUILTIN, OUTPUT);
  pinMode(BP1, INPUT_PULLUP);
  pinMode(BP2, INPUT_PULLUP);
  pinMode(BP3, INPUT_PULLUP);
  pinMode(BP4, INPUT_PULLUP);

  pinMode(BUTTON_PIN, OUTPUT);     // пин нажатия на кнопку
  digitalWrite(BUTTON_PIN, HIGH);  // первичное выставление пина
  pinMode(dynPin, OUTPUT);

  // Подключаемся к WiFi
  WiFi.mode(WIFI_STA);
  WiFi.begin(ssid, password);

  // Ждём подключения WiFi
  int k = 0;
  while (WiFi.status() != WL_CONNECTED) {
    Serial.print(".");
    delay(1000);
    k = k + 1;
  }
  Serial.println();
  Serial.print("IP адрес: ");
  Serial.print(WiFi.localIP());
  Serial.print(" получен за ");
  Serial.print(k);
  Serial.println(" секунд/ы");
  // Подключаемся к серверу
  webSocket.begin(ADDR, PORT, URL);
  Serial.println("Подключаемся к серверу");
  // Метод событий WebSocket
  webSocket.onEvent(webSocketEvent);
  // Если соединение прервано, повторить попытку через 5 сек.
  webSocket.setReconnectInterval(5000);
}


void loop() {

  // Цикл WebSocket
  //Serial.println(digitalRead(16)); // после это строки не работает webSocket.loop
  unsigned long currentMillis = millis();  // текущее время

  // Проверяем, прошло ли 10 секунд
  if (currentMillis - previousMillis >= interval) {
    previousMillis = currentMillis;  // сохраняем время последней отправки

    //SendVoltage();  // отправляем данные
    //47.665989, 40.201729 каменоломни
    if (nextgps >= maxsize) {
      nextgps = 1;
      Serial.println("начинаем новый круг");
    }
    if (nextgps > 0) {
      SendGPS("lon", glon[nextgps]);
      SendGPS("lat", glat[nextgps]);

    } else {
      SendGPS("lon", 40.201729);
      SendGPS("lat", 47.665989);
      //срабатывает 1 раз
    }
    nextgps = nextgps + 1;
    //Serial.println();
  }
  if (currentMillis - previousMillis2 >= interval2) {
    previousMillis2 = currentMillis;
    SendVoltage();  // отправляем данные
  }
  if (currentMillis - previousMillis3 >= interval3) {
    previousMillis3 = currentMillis;
    //Serial.println("Действие каждую секунду");
    nextStateAndSend();
  }

  if (Gbuzz) {
    updateBuzzer();
  }



  webSocket.loop();
  static bool pState = false;
  /*
  bool state = !digitalRead(BUTTON_PIN);
  if (pState != state) {  // состояние изменилось
    pState = state;       // запомнить новое
    if (state) {
      Serial.println("Кнопка нажата");
    } else {
      Serial.println("Кнопка отпущена");
      //Gvoltage =analogRead(0) * VREF * ((DIV_R1 + DIV_R2) / DIV_R2) / 1024;

      nextStateAndSend();
    }
  }
  */

  //Serial.println(digitalRead(16));
  //delay(300);
  if (millis() % 1000 == 0) {

    // Если данные сервера были получены хотябы один раз
    if (rdata[0] != 0) {

      //Serial.println("Текущие данные сервера:");

      // Выводим массив данных в последовательный порт
      //for (size_t i = 0; i < glen; i++)
      //Serial.println(rdata[i]);
      if (!falseInit) {
        falseInit = true;
        mac = String(WiFi.macAddress());
        String mes1 = String("Connnected to server whis mac/sn: ") + mac;
        char JSONMessage[] = "{\"command\":\"registerDeviceClient\",\"DeviceClientUUID\":\"test1\"}";

        Serial.println("Передаём данные при первичном подключении к серверу");
        Serial.println(mes1);
        //webSocket.sendTXT(mac);

        DeserializationError error = deserializeJson(parsed, JSONMessage);

        String command = parsed["command"];
        String DeviceClientUUID = parsed["DeviceClientUUID"];
        //Serial.println(command);
        //Serial.println(DeviceClientUUID);

        //Serial.print("Final string value: ");
        parsed["DeviceClientUUID"] = mac;

        String updatedJson;
        serializeJson(parsed, updatedJson);
        Serial.println(updatedJson);


        webSocket.sendTXT(updatedJson);  // отправляем рег данные {"command":"registerDeviceClient","DeviceClientUUID":"A4:CF:12:BD:A3:66"}
      }
    }
  }
  // Если соединение WiFi прервано
  if (WiFi.status() != WL_CONNECTED) {
    //Вызываем функцию setup(), для повторного подключения
    Serial.println("Reconnect");
    setup();
  }
}

void SendVoltage() {
  Gvoltage = analogRead(0) * VREF * ((DIV_R1 + DIV_R2) / DIV_R2) / 1024;
  //Gvoltage = random(19, 30);
  if (Gvoltage != GcurretnVoltage) {
    char tmpj[] = "";
    StaticJsonDocument<300> sendData;
    deserializeJson(sendData, tmpj);
    sendData["command"] = "deviceDataChanged";
    sendData["deviceUUID"] = mac;
    sendData["deviceData"]["dataKey"] = "voltage";
    sendData["deviceData"]["dataValue"] = Gvoltage;
    String updatedJson;
    serializeJson(sendData, updatedJson);
    Serial.println(updatedJson);
    webSocket.sendTXT(updatedJson);

  } else {
    Serial.print(Gvoltage);
    Serial.println(" - данные не изменились");
  }
  GcurretnVoltage = Gvoltage;
}

void SendGPS(String param, float data) {
  //47.665989, 40.201729 каменоломни
  if ((GcurrentLat != data && param == "lat") || (GcurrentLon != data && param == "lon")) {
    char tmpj[] = "";
    StaticJsonDocument<300> sendData;
    deserializeJson(sendData, tmpj);
    sendData["command"] = "deviceDataChanged";
    sendData["deviceUUID"] = mac;
    sendData["deviceData"]["dataKey"] = param;
    sendData["deviceData"]["dataValue"] = data;
    String updatedJson;
    serializeJson(sendData, updatedJson);
    Serial.println(updatedJson);
    webSocket.sendTXT(updatedJson);
  }
  if (param == "lat") {
    GcurrentLat = data;
  } else {
    GcurrentLon = data;
  }
}

void nextStateAndSend() {
  char tmpj[] = "";


  if (tmpMode != Gmode) {
    Gmode = readdAllPins(BP1, BP2, BP3, BP4);
    delay(100);
    tmpMode = Gmode;
    StaticJsonDocument<300> sendData;
    deserializeJson(sendData, tmpj);
    sendData["command"] = "deviceDataChanged";
    sendData["deviceUUID"] = mac;
    sendData["deviceData"]["dataKey"] = "deviceStatus";
    sendData["deviceData"]["dataValue"] = Gmode * 25;
    String updatedJson;
    serializeJson(sendData, updatedJson);
    //Serial.println(updatedJson);
    //webSocket.sendTXT(updatedJson);
  } else {
    //Serial.println("Данные режима работы не изменились");
    Gmode = readdAllPins(BP1, BP2, BP3, BP4);
  }
}


void webSocketEvent(WStype_t type, uint8_t* payload, size_t length) {

  // Если тип данных двоичный и размер больше нуля
  if (type == WStype_TEXT && length > 0) {
    //Serial.println("ЭВЕНТ");
    String _payload = String((char*)&payload[0]);
    Serial.println(_payload);
    // Преобразуем данные из байтов в десятичные числа без знака
    const unsigned long* tmp = (unsigned long*)payload;
    // Вычисляем размер данных в новом формате
    const size_t len = length / sizeof(*rdata);

    // Записываем в глобальную переменную
    for (size_t i = 0; i < len && i < glen; i++) {
      rdata[i] = tmp[i];
    }
    // блок получения json
    StaticJsonDocument<300> getData;

    DeserializationError error = deserializeJson(getData, _payload);


    // Проверьте, удастся ли выполнить синтаксический анализ.
    if (error) {
      //Serial.print(F("deserializeJson() failed: "));
      //Serial.println(error.f_str());
      //Serial.println(_payload);
      return;
    } else {  //Вывести если ошибок нет

      //Serial.println("получен корректный JSON");
      bool state = getData["clientData"]["lampON"];
      //changeState(state);
      //delay(200);
      //Gmode = readdAllPins(BP1, BP2, BP3, BP4);
      String event = getData["deviceData"]["dataKey"];
      if (event == "deviceStatus") {  // изменён ползунок нажатия кнопки на сервере
        int tmode = getData["deviceData"]["dataValue"];
        setModeTo(Gmode, tmode / 25);
        Gmode = tmode / 25;
      }
      if (event == "lampON") {  // Нажата кнопка переключатель
        changeState(getData["deviceData"]["dataValue"]);
      }
      if (event == "alarm") { // включен спикер
      Serial.print("Активация ПИЩАНИЯ!!!!!");
        Gbuzz=getData["deviceData"]["dataValue"];
      }
    }
  }
}
int readdAllPins(int pin1, int pin2, int pin3, int pin4) {
  bool val1 = digitalRead(pin3);
  bool val2 = digitalRead(pin2);
  bool val3 = digitalRead(pin4);
  bool val4 = digitalRead(pin1);
  int mode = 0;
  if (val1) {
    //Serial.println("Пин 1");
    mode = 1;
  }
  if (val2) {
    //Serial.println("Пин 2");
    mode = 2;
  }
  if (val3) {
    //Serial.println("Пин 3");
    mode = 3;
  }
  if (val4) {
    //Serial.println("Пин 4");
    mode = 4;
  }
  //Serial.println("Текущий режим=" + String(mode));
  return mode;
}


void changeState(bool state) {
  if (state == false) {
    digitalWrite(LED_BUILTIN, HIGH);
    //digitalWrite(BUTTON_PIN, LOW);
    //delay(50);
    //digitalWrite(BUTTON_PIN, HIGH);  // Управление платой заблокировано
    Serial.println("Включено");
    offAll();
  }
  if (state == true) {
    digitalWrite(LED_BUILTIN, LOW);
    //digitalWrite(BUTTON_PIN, HIGH);
    Serial.println("Выключено");
  }
}

void offAll() {
  Serial.print("Выключаем из режима ");
  Serial.println(Gmode);
  int d = 50;
  if (Gmode == 1) {
    lowHigh(d);
    delay(d);
    lowHigh(d);
    delay(d);
    lowHigh(d);
    delay(d);
    lowHigh(d);
  }
  if (Gmode == 2) {
    lowHigh(d);
    delay(d);
    lowHigh(d);
    delay(d);
    lowHigh(d);
  }
  if (Gmode == 3) {
    lowHigh(d);
    delay(d);
    lowHigh(d);
  }
  if (Gmode == 4) {
    lowHigh(d);
  }
  if (Gmode == 0) {
    Serial.println("Устройство уже выключено");
  }
}

void lowHigh(int d) { // из включеного включить
  digitalWrite(BUTTON_PIN, LOW);
  delay(d);
  digitalWrite(BUTTON_PIN, HIGH);
}


void setModeTo(int modeold, int mode) {

  if (modeold != 0) {
    //Serial.println("Делаем предварительное отключение");
    offAll();  // выключаем всё
  }

  int d = 50;
  //Serial.print("Включаем режим ");
  //Serial.println(mode);
  delay(d);
  if (mode == 1) {
    //Serial.print("Режим:");
    //Serial.println(mode);
    lowHigh(d);
  }

  if (mode == 2) {
    //Serial.print("Режим:");
    //Serial.println(mode);
    lowHigh(d);
    delay(d);
    lowHigh(d);
  }
  if (mode == 3) {
    //Serial.print("Режим:");
    //Serial.println(mode);
    lowHigh(d);
    delay(d);
    lowHigh(d);
    delay(d);
    lowHigh(d);
  }
  if (mode == 4) {
    //Serial.print("Режим:");
    //Serial.println(mode);
    lowHigh(d);
    delay(d);
    lowHigh(d);
    delay(d);
    lowHigh(d);
    delay(d);
    lowHigh(d);
  }
}

void updateBuzzer() {
    unsigned long currentMillis = millis();
    
    if (!buzzerState) {
        // Если пищалка выключена, проверяем, не пора ли включить
        if (currentMillis - previousMillis4 >= buzzerOffTime) {
            tone(dynPin, buzzerFrequency);
            buzzerState = true;
            previousMillis4 = currentMillis;
            Serial.print("ПИК!");
        }
    } else {
        // Если пищалка включена, проверяем, не пора ли выключить
        if (currentMillis - previousMillis4 >= buzzerOnTime) {
            noTone(dynPin);
            buzzerState = false;
            previousMillis4 = currentMillis;
        }
    }
}